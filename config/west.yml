## config/west.yml
```yaml
manifest:
  remotes:
    - name: zmkfirmware
      url-base: https://github.com/zmkfirmware
    - name: DiogoDoreto
      url-base: https://github.com/DiogoDoreto
  projects:
    - name: zmk
      remote: DiogoDoreto
      revision: waterfowl-encoders
      import: app/west.yml
  self:
    path: config
```
